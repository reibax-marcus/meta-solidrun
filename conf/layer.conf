## conf/layer.conf
```bitbake
# Add layer directory to bbpath
BBPATH .= ":${LAYERDIR}"

# Add recipe directories
BBFILES += "${LAYERDIR}/recipes-*/*/*.bb \
            ${LAYERDIR}/recipes-*/*/*.bbappend"

BBFILE_COLLECTIONS += "meta-solidrun"
BBFILE_PATTERN_meta-solidrun = "^${LAYERDIR}/"
BBFILE_PRIORITY_meta-solidrun = "8"

LAYERSERIES_COMPAT_meta-solidrun = "gatesgarth hardknott"
```

## conf/machine/cn9130-cf-base.conf
```bitbake
#@TYPE: Machine
#@NAME: cn9130
#@DESCRIPTION: Machine support for Marvell Octeon TX2 CN9130.
#

# Static binaries throw an illegal instruction when using this machine
# The kernel seems to work, and so do dynamically linked binaries, but
# init can't me made to work
#require conf/machine/include/arm/armv8-2a/tune-octeontx2.inc
# We will use generic aarch64 instead
require conf/machine/include/arm/arch-arm64.inc

MACHINE_EXTRA_RRECOMMENDS = "kernel-modules kernel-devicetree"

EXTRA_IMAGEDEPENDS += "\
    virtual/bootloader \
    arm-trusted-firmware \
    "

IMAGE_FSTYPES ?= "tar.gz"
WKS_FILE ?= "cn9130-yocto.wks"
IMAGE_INSTALL_append = " kernel-devicetree kernel-image-image"
do_image_wic[depends] += "mtools-native:do_populate_sysroot dosfstools-native:do_populate_sysroot u-boot:do_deploy"

SERIAL_CONSOLES ?= "115200;ttyS0 115200;ttyO0 115200;ttyAMA0"
SERIAL_CONSOLES_CHECK = "${SERIAL_CONSOLES}"

PREFERRED_PROVIDER_virtual/kernel ?= "linux-yocto"
PREFERRED_VERSION_linux-yocto ?= "5.10%"

KERNEL_IMAGETYPE = "Image"
KERNEL_DEVICETREE = "marvell/cn9130-cf-base.dtb"
KERNEL_EXTRA_ARGS += "LOADADDR=${UBOOT_ENTRYPOINT}"
KERNEL_FEATURES += " cn9130-cf-base.scc "

#SPL_BINARY = "MLO"
UBOOT_SUFFIX = "bin"
UBOOT_MACHINE = "sr_cn913x_cex7_defconfig"
UBOOT_BUILDENV_DEVICE_TREE = "cn9130-cf-base"
#UBOOT_MAKE_TARGET = "u-boot.elf"
#UBOOT_ENTRYPOINT = "0x80000000"
#UBOOT_LOADADDRESS = "0x080008000"

PREFERRED_PROVIDER_virtual/bootloader ?= "u-boot"
PREFERRED_VERSION_virtual/bootloader ?= "2019.10"
PREFERRED_VERSION_u-boot ?= "2019.10"

MACHINE_FEATURES = "rtc ext2 ext3 vfat usbhost"
MACHINE_THREADS = "4"

IMAGE_BOOT_FILES ?= "${KERNEL_IMAGETYPE} ${UBOOT_BINARY}"
```
